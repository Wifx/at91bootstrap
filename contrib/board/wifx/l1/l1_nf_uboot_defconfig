## contrib/board/wifx/l1/l1_nf_uboot_defconfig
```kconfig
CONFIG_L1=y
CONFIG_RAM_256MB=y
# CONFIG_PMECC_AUTO_DETECT is not set
CONFIG_PMECC_CORRECT_BITS_4=y
CONFIG_IMG_SIZE="0x000C0000"
CONFIG_DEBUG=y
# CONFIG_DISABLE_WATCHDOG is not set
# CONFIG_ENTER_NWD is not set
```

## contrib/board/wifx/l1/l1_sd_uboot_defconfig
```kconfig
CONFIG_L1=y
CONFIG_CPU_CLK_600MHZ=y
CONFIG_RAM_256MB=y
CONFIG_SDCARD=y
CONFIG_DEBUG=y
# CONFIG_DISABLE_WATCHDOG is not set
# CONFIG_ENTER_NWD is not set
```

## contrib/board/wifx/lorix_one_256/lorix_one_256_nf_uboot_defconfig
```kconfig
CONFIG_LORIX_ONE_256=y
CONFIG_RAM_128MB=y
CONFIG_IMG_SIZE="0x000C0000"
CONFIG_DEBUG=y
# CONFIG_DISABLE_WATCHDOG is not set
# CONFIG_ENTER_NWD is not set
CONFIG_ACT8865_SET_VOLTAGE=y
# CONFIG_DISABLE_ACT8865_I2C is not set
```
